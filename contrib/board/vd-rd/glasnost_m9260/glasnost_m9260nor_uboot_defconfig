## contrib/board/vd-rd/glasnost_m9260/glasnost_m9260nor_uboot_defconfig
```kconfig
CONFIG_GLASNOST_M9260=y
CONFIG_LONG_FILENAME=n
CONFIG_DATAFLASH=y
CONFIG_RAM_64MB=y
CONFIG_THUMB=y
CONFIG_DISABLE_WATCHDOG=n
```

## contrib/board/vd-rd/glasnost_m9g20/glasnost_m9g20df_uboot_defconfig
```kconfig
CONFIG_GLASNOST_M9G20=y
CONFIG_DATAFLASH=y
CONFIG_RAM_64MB=y
CONFIG_THUMB=y
CONFIG_DISABLE_WATCHDOG=n
```

## contrib/board/vd-rd/glasnost_m9g20/glasnost_m9g20sd_uboot_defconfig
```kconfig
CONFIG_GLASNOST_M9G20=y
CONFIG_SDCARD=y
CONFIG_RAM_64MB=y
CONFIG_THUMB=y
CONFIG_DISABLE_WATCHDOG=n
```

## contrib/board/vd-rd/glasnost_sam9x5/glasnost_sam9x5sd_uboot_defconfig
```kconfig
CONFIG_GLASNOST_SAM9X5=y
CONFIG_RAM_128MB=y
CONFIG_SCLK=y
CONFIG_SDCARD=y
CONFIG_THUMB=y
CONFIG_DISABLE_WATCHDOG=n
```
